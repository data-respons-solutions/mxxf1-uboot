## board/datarespons/cargotec/Kconfig
```kconfig
if TARGET_CARGOTEC

config SYS_BOARD
	default "cargotec"

config SYS_VENDOR
	default "datarespons"


config SYS_CONFIG_NAME
	default "cargotec"

config PMIC_I2C_BUS
	int
	default 0

config FACTORY_BOOT
	bool "Factory boot mode"
	default n
	help
	  Enables the factory installation boot mode

config LOGLEVEL
	int "Kernel loglevel"
	default 4
	
config MXC_USB_OTG_OC_LOW
	bool "OTG overcurrent active low"
	default y

endif
```

## board/datarespons/linkbox-module/Kconfig
```kconfig
if TARGET_LINKBOX_MODULE

config SYS_BOARD
	default "linkbox-module"

config SYS_VENDOR
	default "datarespons"

config SYS_CONFIG_NAME
	default "linkbox-module"

config FACTORY_BOOT
	bool "Factory boot mode"
	default n
	help
	  Enables the factory installation boot mode

config LOGLEVEL
	int "Kernel loglevel"
	default 4

endif
```

## board/datarespons/linkbox2/Kconfig
```kconfig
if TARGET_LINKBOX2

config SYS_BOARD
	default "linkbox2"

config SYS_VENDOR
	default "datarespons"


config SYS_CONFIG_NAME
	default "linkbox2"

config FACTORY_BOOT
	bool "Factory boot mode"
	default n
	help
	  Enables the factory installation boot mode

config LOGLEVEL
	int "Kernel loglevel"
	default 4

endif
```

## board/datarespons/lm-cpu-module/Kconfig
```kconfig
if TARGET_LM_CPU_MODULE

config SYS_BOARD
	default "lm-cpu-module"

config SYS_VENDOR
	default "datarespons"

config SYS_CONFIG_NAME
	default "lm-cpu-module"

config FACTORY_BOOT
	bool "Factory boot mode"
	default n
	help
	  Enables the factory installation boot mode

config LOGLEVEL
	int "Kernel loglevel"
	default 4

endif
```

## board/datarespons/mxxf1/Kconfig
```kconfig
if TARGET_MXXF1

config SYS_BOARD
	default "mxxf1"

config SYS_VENDOR
	default "datarespons"

config SYS_CONFIG_NAME
	default "mxxf1"

endif
```

## board/datarespons/simpad-wb/Kconfig
```kconfig
if TARGET_SIMPAD_WB

config SYS_BOARD
	default "simpad-wb"

config SYS_VENDOR
	default "datarespons"

config SYS_SOC
	default "mx6"

config SYS_CONFIG_NAME
	default "simpad-wb"

endif
```

## board/datarespons/simpad2/Kconfig
```kconfig
if TARGET_LM_SIMPAD2

config SYS_BOARD
	default "simpad2"

config SYS_VENDOR
	default "datarespons"

config SYS_SOC
	default "mx6"

config SYS_CONFIG_NAME
	default "simpad2"

endif
```

## board/datarespons/sperre/Kconfig
```kconfig
if TARGET_SPERRE

config SYS_BOARD
	default "sperre"

config SYS_VENDOR
	default "datarespons"

config SYS_SOC
	default "mx6"

config SYS_CONFIG_NAME
	default "sperre"

endif
```

## board/dfi/fs700/Kconfig
```kconfig
if TARGET_FS700

config SYS_BOARD
	default "fs700"

config SYS_VENDOR
	default "dfi"

config SYS_SOC
	default "mx6"

config SYS_CONFIG_NAME
	default "fs700"

endif
```

## configs/cargotec_hab_spl_defconfig
```kconfig
CONFIG_ARM=y
CONFIG_ARCH_MX6=y
CONFIG_SYS_TEXT_BASE=0x17800000
CONFIG_TARGET_CARGOTEC=y
CONFIG_SYS_EXTRA_OPTIONS="IMX_CONFIG=board/datarespons/cargotec/mx6dl.cfg,MX6QDL,SECURE_BOOT"
CONFIG_BOOTDELAY=3
CONFIG_AUTOBOOT_STOP_STR_SHA256="6c45cb72a36e63d522aa54ed8adbd7a29a989474f2f77e0458af8800564ef3cb"
CONFIG_AUTOBOOT_KEYED=y
CONFIG_AUTOBOOT_ENCRYPTION=y
CONFIG_HUSH_PARSER=y
CONFIG_CMD_BOOTZ=y
CONFIG_CMD_MMC=y
CONFIG_CMD_I2C=y
CONFIG_CMD_USB=y
CONFIG_CMD_USB_MASS_STORAGE=y
CONFIG_CMD_GPIO=y
CONFIG_CMD_DHCP=y
CONFIG_CMD_MII=y
CONFIG_CMD_PING=y
CONFIG_CMD_CACHE=y
CONFIG_CMD_EXT2=y
CONFIG_CMD_EXT4=y
CONFIG_CMD_EXT4_WRITE=y
CONFIG_CMD_FAT=y
CONFIG_CMD_FS_GENERIC=y
CONFIG_USB=y
CONFIG_USB_STORAGE=y
CONFIG_USB_GADGET=y
CONFIG_CI_UDC=y
CONFIG_USB_GADGET_DOWNLOAD=y
CONFIG_G_DNL_MANUFACTURER="DR"
CONFIG_G_DNL_VENDOR_NUM=0x0525
CONFIG_G_DNL_PRODUCT_NUM=0xa4a5
CONFIG_OF_LIBFDT=y
CONFIG_DEFAULT_FDT_FILE	"/boot/cargotec_revA.dtb"
CONFIG_SPL_GPIO_SUPPORT=y
CONFIG_SPL_LIBCOMMON_SUPPORT=y
CONFIG_SPL_LIBGENERIC_SUPPORT=y
CONFIG_SPL_MMC_SUPPORT=y
CONFIG_SPL_SERIAL_SUPPORT=y
CONFIG_SPL_LIBDISK_SUPPORT=y
CONFIG_SPL_WATCHDOG_SUPPORT=y
CONFIG_SPL=y
CONFIG_SPL_EXT_SUPPORT=y
CONFIG_SPL_I2C_SUPPORT=y
CONFIG_SPL_OS_BOOT=n
CONFIG_MX6_DDRCAL=y
CONFIG_CMD_PART=y
CONFIG_PARTITIONS=y
CONFIG_EFI_PARTITION=y
CONFIG_PARTITION_UUIDS=y
CONFIG_PARTITION_TYPE_GUID=y
CONFIG_MMC_HW_PARTITIONING=y
CONFIG_SUPPORT_EMMC_BOOT=y
CONFIG_FSL_CAAM=y
```

## configs/fs700_defconfig
```kconfig
CONFIG_SYS_EXTRA_OPTIONS="IMX_CONFIG=board/dfi/fs700/mx6dl_64.cfg,MX6DL"
+S:CONFIG_ARM=y
+S:CONFIG_TARGET_FS700=y
```

## configs/linkbox-module_factory_defconfig
```kconfig
CONFIG_SYS_EXTRA_OPTIONS="IMX_CONFIG=board/datarespons/linkbox-module/mx6dl.cfg,FACTORY_BOOT,MX6DL"
CONFIG_ARM=y
CONFIG_ARCH_MX6=y
CONFIG_TARGET_LINKBOX_MODULE=y
```

## configs/linkbox-module_spl_defconfig
```kconfig
CONFIG_SPL=y
CONFIG_SYS_EXTRA_OPTIONS="IMX_CONFIG=board/datarespons/linkbox-module/spl_spi.cfg,SPL,MX6DL"
CONFIG_ARM=y
CONFIG_ARCH_MX6=y
CONFIG_TARGET_LINKBOX_MODULE=y
```

## configs/linkbox2_defconfig
```kconfig
CONFIG_SYS_EXTRA_OPTIONS="IMX_CONFIG=board/datarespons/linkbox2/mx6dl.cfg,MX6DL"
CONFIG_ARM=y
CONFIG_ARCH_MX6=y
CONFIG_TARGET_LINKBOX2=y
```

## configs/linkbox2_spl_defconfig
```kconfig
# Common values
CONFIG_ARM=y
CONFIG_ARCH_MX6=y
CONFIG_TARGET_LINKBOX2=y
CONFIG_SYS_TEXT_BASE=0x17800000

CONFIG_BOOTDELAY=3
# CONFIG_CONSOLE_MUX is not set
CONFIG_HUSH_PARSER=y
CONFIG_CMD_BOOTZ=y
# CONFIG_CMD_IMLS is not set
# CONFIG_CMD_FLASH is not set
CONFIG_CMD_MMC=y
CONFIG_CMD_SF=y
CONFIG_CMD_I2C=y
CONFIG_CMD_USB=y
CONFIG_CMD_DFU=y
CONFIG_CMD_USB_MASS_STORAGE=y
CONFIG_CMD_GPIO=y
CONFIG_CMD_DHCP=y
CONFIG_CMD_MII=y
CONFIG_CMD_PING=y
CONFIG_CMD_CACHE=y
CONFIG_CMD_EXT2=y
CONFIG_CMD_EXT4=y
CONFIG_CMD_EXT4_WRITE=y
CONFIG_CMD_FAT=y
CONFIG_CMD_FS_GENERIC=y
CONFIG_PARTITIONS=y
CONFIG_CMD_PART=y
CONFIG_EFI_PARTITION=y
CONFIG_PARTITION_UUIDS=y
CONFIG_PARTITION_TYPE_GUID=y
CONFIG_DFU_MMC=y
CONFIG_DFU_SF=y
CONFIG_SPI=y
CONFIG_MXC_SPI=y
CONFIG_FSL_ESDHC=y
CONFIG_SPI_FLASH=y
CONFIG_SPI_FLASH_STMICRO=y
CONFIG_USB=y
CONFIG_USB_STORAGE=y
CONFIG_USB_GADGET=y
CONFIG_CI_UDC=y
CONFIG_USB_GADGET_DOWNLOAD=y
CONFIG_USB_GADGET_MANUFACTURER="FSL"
CONFIG_USB_GADGET_VENDOR_NUM=0x0525
CONFIG_USB_GADGET_PRODUCT_NUM=0xa4a5
CONFIG_G_DNL_MANUFACTURER="DR"
CONFIG_G_DNL_VENDOR_NUM=0x0525
CONFIG_G_DNL_PRODUCT_NUM=0xa4a5
# CONFIG_VIDEO_SW_CURSOR is not set
CONFIG_OF_LIBFDT=y
CONFIG_DEFAULT_FDT_FILE	"/boot/linkbox2-revC.dtb"
CONFIG_ENV_IS_NOWHERE=y
CONFIG_PHYLIB=y
CONFIG_NETDEVICES=y

CONFIG_MXC_UART=y

# SPLs

CONFIG_SYS_EXTRA_OPTIONS="IMX_CONFIG=board/datarespons/linkbox2/spl_spi.cfg"

CONFIG_SPL=y
CONFIG_SPL_LIBCOMMON_SUPPORT=y
CONFIG_SPL_LIBGENERIC_SUPPORT=y
CONFIG_SPL_MMC_SUPPORT=y
CONFIG_SPL_SERIAL_SUPPORT=y
CONFIG_SPL_WATCHDOG_SUPPORT=y
CONFIG_SPL_I2C_SUPPORT=y
CONFIG_SPL_GPIO_SUPPORT=y
CONFIG_SPL_USB_HOST_SUPPORT=y
CONFIG_SPL_USB_GADGET_SUPPORT=y
CONFIG_SPL_USB_SDP_SUPPORT=y
#CONFIG_MX6_DDRCAL=y
```

## configs/mxxf1_defconfig
```kconfig
CONFIG_ARM=y
CONFIG_ARCH_MX6=y
CONFIG_SYS_TEXT_BASE=0x17800000
CONFIG_TARGET_MXXF1=y
CONFIG_SYS_EXTRA_OPTIONS="IMX_CONFIG=board/datarespons/mxxf1/mx6q_4x_mt41j128.cfg"
CONFIG_BOOTDELAY=3
CONFIG_HUSH_PARSER=y
CONFIG_CMD_BOOTZ=y
CONFIG_CMD_MMC=y
CONFIG_CMD_I2C=y
CONFIG_CMD_USB=y
CONFIG_CMD_USB_MASS_STORAGE=y
CONFIG_CMD_GPIO=y
CONFIG_CMD_DHCP=y
CONFIG_CMD_MII=y
CONFIG_CMD_PING=y
CONFIG_CMD_CACHE=y
CONFIG_CMD_EXT2=y
CONFIG_CMD_EXT4=y
CONFIG_CMD_EXT4_WRITE=y
CONFIG_CMD_FAT=y
CONFIG_CMD_FS_GENERIC=y
CONFIG_CMD_SATA=y
CONFIG_USB=y
CONFIG_USB_STORAGE=y
CONFIG_USB_GADGET=y
CONFIG_CI_UDC=y
CONFIG_USB_GADGET_DOWNLOAD=y
CONFIG_G_DNL_MANUFACTURER="DR"
CONFIG_G_DNL_VENDOR_NUM=0x0525
CONFIG_G_DNL_PRODUCT_NUM=0xa4a5
CONFIG_OF_LIBFDT=y
CONFIG_DEFAULT_FDT_FILE	"/boot/mxxf1.dtb"
CONFIG_CMD_PART=y
CONFIG_PARTITIONS=y
CONFIG_EFI_PARTITION=y
CONFIG_PARTITION_UUIDS=y
CONFIG_PARTITION_TYPE_GUID=y
# CONFIG_CMD_IMLS is not set
# CONFIG_CMD_FLASH is not set
CONFIG_MMC_HW_PARTITIONING=y
CONFIG_ENV_IS_IN_SPI_FLASH=y
CONFIG_ENV_VARS_UBOOT_RUNTIME_CONFIG=y
CONFIG_SATA=y
CONFIG_BOARD_EARLY_INIT_F=y

CONFIG_SYS_PROMPT="MXXF1 iMX6 # "
CONFIG_SPL_GPIO_SUPPORT=y
CONFIG_SPL_LIBCOMMON_SUPPORT=y
CONFIG_SPL_LIBGENERIC_SUPPORT=y
CONFIG_DISPLAY_BOARDINFO_LATE=y
CONFIG_SPI=y
CONFIG_SPI_FLASH=y
CONFIG_SPI_FLASH_STMICRO=y
CONFIG_MXC_SPI=y
CONFIG_SPI_BOOT=y
CONFIG_CMD_SF=y
CONFIG_FSL_ESDHC=y
CONFIG_VIDEO=y
CONFIG_CONSOLE_MUX
CONFIG_SYS_USB_EVENT_POLL_VIA_CONTROL_EP
CONFIG_SYS_STDIO_DEREGISTER=y
CONFIG_MXC_USB_OTG_HACTIVE=y
```

## configs/mxxf1_spl_defconfig
```kconfig
CONFIG_SPL=y
CONFIG_SYS_EXTRA_OPTIONS="IMX_CONFIG=board/datarespons/mxxf1/spl_spi.cfg,SPL,MX6Q"
CONFIG_ARM=y
CONFIG_ARCH_MX6=y
CONFIG_TARGET_MXXF1=y
```

## configs/simpad2_defconfig
```kconfig
CONFIG_SYS_EXTRA_OPTIONS="IMX_CONFIG=board/datarespons/simpad2/mx6dl_64.cfg,MX6DL"
CONFIG_ARM=y
CONFIG_ARCH_MX6=y
CONFIG_TARGET_SIMPAD2=y
```

## configs/simpad2_sabresd_spl_defconfig
```kconfig
CONFIG_SPL=y
CONFIG_SYS_EXTRA_OPTIONS="IMX_CONFIG=board/datarespons/simpad2/spl_spi.cfg,MX6Q,SPL,EMU_SABRESD"
+S:CONFIG_ARM=y
+S:CONFIG_TARGET_SIMPAD2=y
```

## configs/simpad2_spl_defconfig
```kconfig
# Common values
CONFIG_ARM=y
CONFIG_ARCH_MX6=y
CONFIG_TARGET_LM_SIMPAD2=y
CONFIG_SYS_TEXT_BASE=0x17800000

CONFIG_BOOTDELAY=3
# CONFIG_CONSOLE_MUX is not set
CONFIG_HUSH_PARSER=y
CONFIG_CMD_BOOTZ=y
# CONFIG_CMD_IMLS is not set
# CONFIG_CMD_FLASH is not set
CONFIG_CMD_MMC=y
CONFIG_CMD_SF=y
CONFIG_CMD_I2C=y
CONFIG_CMD_USB=y
CONFIG_CMD_DFU=y
CONFIG_CMD_USB_MASS_STORAGE=y
CONFIG_CMD_GPIO=y
CONFIG_CMD_DHCP=y
CONFIG_CMD_MII=y
CONFIG_CMD_PING=y
CONFIG_CMD_CACHE=y
CONFIG_CMD_EXT2=y
CONFIG_CMD_EXT4=y
CONFIG_CMD_EXT4_WRITE=y
CONFIG_CMD_FAT=y
CONFIG_CMD_FS_GENERIC=y
CONFIG_PARTITIONS=y
CONFIG_CMD_PART=y
CONFIG_EFI_PARTITION=y
CONFIG_PARTITION_UUIDS=y
CONFIG_PARTITION_TYPE_GUID=y
CONFIG_DFU_MMC=y
CONFIG_DFU_SF=y
CONFIG_SPI=y
CONFIG_MXC_SPI=y
CONFIG_FSL_ESDHC=y
CONFIG_SPI_FLASH=y
CONFIG_SPI_FLASH_STMICRO=y
CONFIG_USB=y
CONFIG_USB_STORAGE=y
CONFIG_USB_GADGET=ySYS_CONSOLE_IS_IN_ENV
CONFIG_CI_UDC=y
CONFIG_USB_GADGET_DOWNLOAD=y
CONFIG_USB_GADGET_MANUFACTURER="FSL"
CONFIG_USB_GADGET_VENDOR_NUM=0x0525
CONFIG_USB_GADGET_PRODUCT_NUM=0xa4a5
CONFIG_G_DNL_MANUFACTURER="DR"
CONFIG_G_DNL_VENDOR_NUM=0x0525
CONFIG_G_DNL_PRODUCT_NUM=0xa4a5
# CONFIG_VIDEO_SW_CURSOR is not set
CONFIG_OF_LIBFDT=y
CONFIG_DEFAULT_FDT_FILE	"/boot/simpad2-revC.dtb"
CONFIG_ENV_IS_NOWHERE=y
CONFIG_PHYLIB=y
CONFIG_NETDEVICES=y

CONFIG_VIDEO=y
CONFIG_VIDEO_IPUV3=y
CONFIG_SYS_CONSOLE_FG_COL=0x00
CONFIG_SYS_CONSOLE_BG_COL=0xff
CONFIG_MXC_UART=y
CONFIG_SYS_CONSOLE_OVERWRITE_ROUTINE=y
CONFIG_SYS_CONSOLE_IS_IN_ENV=y
CONFIG_SYS_STDIO_DEREGISTER=y

# SPLs

CONFIG_SYS_EXTRA_OPTIONS="IMX_CONFIG=board/datarespons/simpad2/spl_spi.cfg"

CONFIG_SPL=y
CONFIG_SPL_LIBCOMMON_SUPPORT=y
CONFIG_SPL_LIBGENERIC_SUPPORT=y
CONFIG_SPL_MMC_SUPPORT=y
CONFIG_SPL_SERIAL_SUPPORT=y
CONFIG_SPL_LIBDISK_SUPPORT=y
CONFIG_SPL_WATCHDOG_SUPPORT=y
CONFIG_SPL_SPI_LOAD=y
CONFIG_SPL_EXT_SUPPORT=y
CONFIG_SPL_I2C_SUPPORT=y
CONFIG_SPL_OS_BOOT=n
CONFIG_SPL_SPI_SUPPORT=y
CONFIG_SPL_SPI_FLASH_SUPPORT=y
CONFIG_SPL_SPI_BOOT=y
CONFIG_SPL_GPIO_SUPPORT=y
CONFIG_SPL_USB_HOST_SUPPORT=y
CONFIG_SPL_USB_GADGET_SUPPORT=y
CONFIG_SPL_USB_SDP_SUPPORT=y
```

## configs/sperre_defconfig
```kconfig
CONFIG_SYS_EXTRA_OPTIONS="IMX_CONFIG=board/datarespons/sperre/mx6dl.cfg,MX6DL"
CONFIG_ARM=y
CONFIG_ARCH_MX6=y
CONFIG_TARGET_SPERRE=y
```

## configs/sperre_factory_defconfig
```kconfig
# i.MX6 Dual Lite == i.MX6 Solo
CONFIG_SYS_EXTRA_OPTIONS="IMX_CONFIG=board/datarespons/sperre/mx6dl.cfg,FACTORY_BOOT,MX6DL"
CONFIG_ARM=y
CONFIG_ARCH_MX6=y
CONFIG_TARGET_SPERRE=y
```
